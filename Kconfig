## Kconfig
```kconfig
menuconfig AD4130
    bool "AD4130"
    help
        "enable AD4130 driver"

if AD4130
config AD4130_FIFO_LEVEL
    int "fifo water mark for interupt"
    default 10
endif
```

## dts/bindings/ad,ad4130/ad,ad4130-common.yaml
```yaml
# Copyright (c) 2024 wimanshahb@gmail.com
# All rights reserved.

properties:
  
    irq-gpios:
      type: phandle-array
      required: true
      description: IRQ pin (active high)
```

## dts/bindings/ad,ad4130/ad,ad4130-spi.yaml
```yaml
# Copyright (c) 2024 wimanshahb@gmail.com
# All rights reserved.

description: driver for ad4130 ADC
compatible: "ad,ad4130"
include: ["spi-device.yaml","ad,ad4130-common.yaml"]
```
